/*
 * SSD1306 driver for the 0.42" 72x40 OLED found on ESP32-C3 SuperMini
 * OLED boards. I2C: SDA=GPIO5, SCL=GPIO6, address 0x3C.
 *
 * The 72x40 panel is wired to the middle of the SSD1306's 128x64 RAM,
 * so every column write must be shifted by 28 pixels.
 */

#include <string.h>

#include "display.h"
#include "driver/i2c_master.h"
#include "esp_log.h"
#include "freertos/FreeRTOS.h"
#include "freertos/semphr.h"

#define I2C_SDA_GPIO      5
#define I2C_SCL_GPIO      6
#define I2C_FREQ_HZ       400000
#define OLED_I2C_ADDR     0x3C
#define OLED_COL_OFFSET   28
#define I2C_TIMEOUT_MS    1000

/* SSD1306 control bytes */
#define CTRL_CMD          0x00
#define CTRL_DATA         0x40

static const char *TAG = "display";

static i2c_master_dev_handle_t s_dev;
static uint8_t s_framebuffer[DISPLAY_PAGES][DISPLAY_WIDTH];
static SemaphoreHandle_t s_mutex;

/* Classic 5x7 font, ASCII 32..126, column-major, LSB = top pixel. */
static const uint8_t font5x7[][5] = {
    {0x00,0x00,0x00,0x00,0x00}, /* space */
    {0x00,0x00,0x5F,0x00,0x00}, /* ! */
    {0x00,0x07,0x00,0x07,0x00}, /* " */
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    {0x08,0x08,0x2A,0x1C,0x08}, /* ~ */
};

static esp_err_t send_commands(const uint8_t *cmds, size_t len)
{
    uint8_t buf[40];
    buf[0] = CTRL_CMD;
    memcpy(&buf[1], cmds, len);
    return i2c_master_transmit(s_dev, buf, len + 1, I2C_TIMEOUT_MS);
}

void display_lock(void)
{
    xSemaphoreTake(s_mutex, portMAX_DELAY);
}

void display_unlock(void)
{
    xSemaphoreGive(s_mutex);
}

esp_err_t display_init(void)
{
    s_mutex = xSemaphoreCreateMutex();

    i2c_master_bus_config_t bus_config = {
        .i2c_port = I2C_NUM_0,
        .sda_io_num = I2C_SDA_GPIO,
        .scl_io_num = I2C_SCL_GPIO,
        .clk_source = I2C_CLK_SRC_DEFAULT,
        .glitch_ignore_cnt = 7,
        .flags.enable_internal_pullup = true,
    };
    i2c_master_bus_handle_t bus;
    esp_err_t err = i2c_new_master_bus(&bus_config, &bus);
    if (err != ESP_OK) {
        return err;
    }

    i2c_device_config_t dev_config = {
        .dev_addr_length = I2C_ADDR_BIT_LEN_7,
        .device_address = OLED_I2C_ADDR,
        .scl_speed_hz = I2C_FREQ_HZ,
    };
    err = i2c_master_bus_add_device(bus, &dev_config, &s_dev);
    if (err != ESP_OK) {
        return err;
    }

    static const uint8_t init_cmds[] = {
        0xAE,             /* display off */
        0xD5, 0x80,       /* clock divide ratio / oscillator */
        0xA8, 0x27,       /* multiplex ratio: 40 rows */
        0xD3, 0x00,       /* display offset */
        0x40,             /* display start line 0 */
        0x8D, 0x14,       /* enable charge pump */
        0x20, 0x00,       /* horizontal addressing mode */
        0xA1,             /* segment remap (flip X) */
        0xC8,             /* COM scan direction (flip Y) */
        0xDA, 0x12,       /* COM pins: alternative config */
        0xAD, 0x30,       /* internal IREF, needed on 0.42" panels */
        0x81, 0xBF,       /* contrast */
        0xD9, 0xF1,       /* pre-charge period */
        0xDB, 0x20,       /* VCOMH deselect level */
        0xA4,             /* resume from RAM content */
        0xA6,             /* normal (non-inverted) display */
    };
    err = send_commands(init_cmds, sizeof(init_cmds));
    if (err != ESP_OK) {
        ESP_LOGE(TAG, "init commands failed: %s", esp_err_to_name(err));
        return err;
    }

    display_clear();
    err = display_flush();
    if (err != ESP_OK) {
        return err;
    }

    static const uint8_t display_on = 0xAF;
    return send_commands(&display_on, 1);
}

void display_clear(void)
{
    memset(s_framebuffer, 0, sizeof(s_framebuffer));
}

void display_draw_text(int x, int page, const char *text)
{
    if (page < 0 || page >= DISPLAY_PAGES) {
        return;
    }
    for (const char *p = text; *p != '\0'; p++) {
        char c = (*p < 32 || *p > 126) ? '?' : *p;
        const uint8_t *glyph = font5x7[c - 32];
        for (int col = 0; col < 5; col++, x++) {
            if (x >= 0 && x < DISPLAY_WIDTH) {
                s_framebuffer[page][x] = glyph[col];
            }
        }
        x++; /* 1 pixel spacing between characters */
    }
}

void display_draw_pixel(int x, int y, bool on)
{
    if (x < 0 || x >= DISPLAY_WIDTH || y < 0 || y >= DISPLAY_HEIGHT) {
        return;
    }

    uint8_t mask = (uint8_t)(1U << (y % 8));
    uint8_t *cell = &s_framebuffer[y / 8][x];
    if (on) {
        *cell |= mask;
    } else {
        *cell &= ~mask;
    }
}

esp_err_t display_flush(void)
{
    const uint8_t window_cmds[] = {
        0x21, OLED_COL_OFFSET, OLED_COL_OFFSET + DISPLAY_WIDTH - 1,
        0x22, 0x00, DISPLAY_PAGES - 1,
    };
    esp_err_t err = send_commands(window_cmds, sizeof(window_cmds));
    if (err != ESP_OK) {
        return err;
    }

    uint8_t buf[1 + sizeof(s_framebuffer)];
    buf[0] = CTRL_DATA;
    memcpy(&buf[1], s_framebuffer, sizeof(s_framebuffer));
    return i2c_master_transmit(s_dev, buf, sizeof(buf), I2C_TIMEOUT_MS);
}
